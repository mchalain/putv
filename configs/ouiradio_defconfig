## packages/buildroot/package/putv/Config.in
```kconfig
menu "Putv"

config BR2_PACKAGE_PUTV
	bool "putv: Embedded media streamer"
	select BR2_PACKAGE_LIBMAD
	select BR2_PACKAGE_JANSSON
	select BR2_PACKAGE_SQLITE
	select BR2_PACKAGE_LIBID3TAG
	select BR2_PACKAGE_ALSA_LIB
	select BR2_PACKAGE_LAME
	select BR2_PACKAGE_FLAC
	select BR2_PACKAGE_FAAD2
	select BR2_PACKAGE_LIBCURL
	help
	  https://github.com/ouistiti-project

config BR2_PACKAGE_PUTV_WEBAPP
	bool "install web interface"
	depends on BR2_PACKAGE_PUTV

config BR2_PACKAGE_PUTV_UPNPRENDERER
	bool "Enable Upnp renderer"
	select BR2_PACKAGE_GMRENDER_RESURRECT2
	depends on BR2_PACKAGE_PUTV

endmenu
```

## packages/buildroot/package/tinysvcmdns/Config.in
```kconfig
config BR2_PACKAGE_TINYSVCMDNS
	bool "tinysvcmdns"
	help
	  Small library to support mDns protocol
	  May expose service to the network
	  https://github.com/tinysvcmdns-ng/tinysvcmdns
```
